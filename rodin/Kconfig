## rodin/Kconfig
```kconfig
config RODIN
	bool "Revenant /proc/rodin game-mode control interface"
	default y
	help
	  Kernel-owned control surface at /proc/rodin for the Revenant
	  game-mode stack (modes, thermal profile, whitelist, stats).

	  The companion app (RodinTools) writes here and the kernel applies
	  the levers internally, sidestepping the SELinux denials that block
	  the app from poking vendor sysfs directly (SCOPE I6/J5).

	  v0 is interface-only and performs no system mutation at boot, so it
	  cannot cause a bootloop. Say Y.
```

## tools/stock-recovery/runtime-audit/Kconfig
```kconfig
# Disposable VM audit only. Do not source this in a shipping tree.
config XIAOMI_DMABUF_RUNTIME_AUDIT
	bool "Disposable VM producer for recovered DMA mapper"
	depends on XIAOMI_DMABUF_HUGETLB && ARM64_4K_PAGES && ARM64_VA_BITS_39
	depends on DMA_SHARED_BUFFER
	default n
	help
	  Creates four mapper devices and one fixed-size DMA-BUF factory,
	  all root-only and mapping only their own zeroed RAM.
	  Built-in only. No arbitrary PFN interface. Not for phone installation.
	  Runtime MMU/SMP and unwind validation remains mandatory.
```
